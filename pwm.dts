/*
 * pwm.dts
 * Device Tree Overlay for 3.3V PWM output
 *
 * Copyright (C) 2020 Google LLC
 *
 * This program is free software; you can redistribute it and/or modify
 * it under the terms of the GNU General Public License as published by
 * the Free Software Foundation; either version 2 of the License, or
 * (at your option) any later version.
 *
 * This program is distributed in the hope that it will be useful,
 * but WITHOUT ANY WARRANTY; without even the implied warranty of
 * MERCHANTABILITY or FITNESS FOR A PARTICULAR PURPOSE. See the
 * GNU General Public License for more details.
 *
 */
/dts-v1/;
/plugin/;
/ {
	compatible = "fsl,imx8mq-phanbell", "fsl,imx8mq";
	fragment@0 {
		target-path = "/iomuxc@30330000";
		__overlay__ {
			status = "okay";
			imx8mq-phanbell {
				
				pinctrl_pwm2: pwm2 {
					fsl,pins = <
						0x05C 0x2C4 0x000 0x5 0x0 0x06 /* MX8MQ_IOMUXC_GPIO1_IO13_PWM2_OUT */
					>;
				};
			};
		};
	};
};

